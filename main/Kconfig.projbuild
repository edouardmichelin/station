## main/Kconfig.projbuild
```kconfig
menu "Example Configuration"

    config WEATHER_SCREEN_REFRESH_RATE_MS
        int "Weather screen refresh rate (ms)"
        default 1000

    choice TEMP_I2C_ADDRESS
        prompt "Select I2C address"
        default TEMP_I2C_ADDRESS_GND
        help
            Select I2C address

        config TEMP_I2C_ADDRESS_GND
            bool "AHT_I2C_ADDRESS_GND"
            help
                Choose this when ADDR pin is connected to ground
        config TEMP_I2C_ADDRESS_VCC
            bool "AHT_I2C_ADDRESS_VCC"
            help
                Choose this when ADDR pin is connected to VCC
    endchoice

    choice EXAMPLE_LCD_CONTROLLER
        prompt "LCD controller model"
        default EXAMPLE_LCD_CONTROLLER_SSD1306
        help
            Select LCD controller model

        config EXAMPLE_LCD_CONTROLLER_SSD1306
            bool "SSD1306"

        config EXAMPLE_LCD_CONTROLLER_SH1107
            bool "SH1107"
    endchoice

    if EXAMPLE_LCD_CONTROLLER_SSD1306
        choice EXAMPLE_SSD1306_HEIGHT
            prompt "SSD1306 Height in pixels"
            default EXAMPLE_SSD1306_HEIGHT_64
            help
                Height of the display in pixels. a.k.a vertical resolution

            config EXAMPLE_SSD1306_HEIGHT_64
                bool "64"
            config EXAMPLE_SSD1306_HEIGHT_32
                bool "32"
        endchoice

        config EXAMPLE_SSD1306_HEIGHT
            int
            default 64 if EXAMPLE_SSD1306_HEIGHT_64
            default 32 if EXAMPLE_SSD1306_HEIGHT_32
    endif
endmenu
```
